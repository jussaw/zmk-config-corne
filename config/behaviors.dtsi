/ {
    behaviors {
        hyper: mod_morph {
            compatible = "zmk,behavior-mod-morph";
            #binding-cells = <0>;
            bindings = <&kp NO>;
            mods = <(MOD_LCTL | MOD_LSFT | MOD_LALT | MOD_LGUI)>;
        };

        &mt {
            flavor = "tap-preferred";
            require-prior-idle-ms = <200>;
            tapping-term-ms = <200>; 
            quick-tap-ms = <150>;
        };
    };
};