## config/west.yml
```yaml
manifest:
  defaults:
    revision: main
  remotes:
    - name: zmkfirmware
      url-base: https://github.com/zmkfirmware
    # m165437 is a custom remote for the nice-view-gem project
    - name: m165437
      url-base: https://github.com/M165437
    # nguyendown is a custom remote for the zmk-behavior-socd module
    - name: nguyendown
      url-base: https://github.com/nguyendown
    # Additional modules containing boards/shields/custom code can be listed here as well
    # See https://docs.zephyrproject.org/3.2.0/develop/west/manifest.html#projects
  projects:
    - name: zmk
      remote: zmkfirmware
      import: app/west.yml
    - name: nice-view-gem
      remote: m165437
      revision: main
    - name: zmk-behavior-socd
      remote: nguyendown
      revision: main
  self:
    path: config
```

## modules/zmk-behavior-socd/dts/bindings/behaviors/behaviors.yaml
```yaml
# Copyright (c) 2021 The ZMK Contributors
# SPDX-License-Identifier: MIT

description: ZMK Behavior

properties:
  display-name:
    type: string
    required: false
```

## modules/zmk-behavior-socd/dts/bindings/behaviors/zmk,behavior-socd.yaml
```yaml
description: SOCD last-input-priority behavior

compatible: "zmk,behavior-socd"

include: behaviors.yaml

properties:
  "#binding-cells":
    type: int
    const: 2
```
